## firmware/config/sdkconfig.defaults
```kconfig
CONFIG_SPIRAM=y
CONFIG_SPIRAM_BOOT_INIT=y
CONFIG_SPIRAM_USE_MALLOC=y
CONFIG_OV5640_SUPPORT=y
CONFIG_SCCB_CLK_FREQ=50000
CONFIG_CAMERA_DMA_BUFFER_SIZE_MAX=65536
CONFIG_CAMERA_TASK_STACK_SIZE=6144
```
